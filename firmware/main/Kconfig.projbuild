## firmware/main/Kconfig.projbuild
```kconfig
menu "Arabic LED text pipeline"

    menu "MAX7219 wiring"

        config MAX7219_PIN_CLK
            int "CLK (SPI clock) GPIO"
            default 14
            help
                GPIO14 is HSPI's native SCK, and sits on the same header edge
                as VIN/GND. See docs/wiring.md.

        config MAX7219_PIN_DIN
            int "DIN (SPI MOSI) GPIO"
            default 13
            help
                GPIO13 is HSPI's native MOSI, adjacent to GND on the power edge.

        config MAX7219_PIN_CS
            int "CS (chip select / LOAD) GPIO"
            default 27
            help
                GPIO27, not the physically closer GPIO12: GPIO12 is the MTDI
                strapping pin and must be LOW at reset. A MAX7219 CS line
                floating or pulled high at boot would select 1.8V flash and
                brick the boot until the wire is removed.

        config MAX7219_COLS
            int "Modules across (horizontal)"
            range 1 16
            default 1
            help
                Panel width is COLS * 8 pixels. 1 for a single 8x8 module,
                4 for the common "4-in-1" stick (32x8).

        config MAX7219_ROWS
            int "Modules down (vertical)"
            range 1 8
            default 1
            help
                Panel height is ROWS * 8 pixels. Leave at 1 for a single
                horizontal strip; raise it when stacking strips to get taller
                text. 4 cols x 2 rows gives 32x16, for example.

        choice MAX7219_CHAIN
            prompt "Chain layout (only matters when ROWS > 1)"
            default MAX7219_CHAIN_ROWMAJOR
            help
                The modules are one electrical daisy-chain even when arranged
                as a grid. This says how the ribbon runs between rows.

            config MAX7219_CHAIN_ROWMAJOR
                bool "Row-major - every row restarts at the left"
            config MAX7219_CHAIN_SERPENT
                bool "Serpentine - alternate rows run right-to-left"
        endchoice

        config MAX7219_INTENSITY
            int "Initial brightness (0-15)"
            range 0 15
            default 2
            help
                MAX7219 at full intensity draws a lot of current; 2 is a safe
                default for USB-powered bring-up.

    endmenu

    config MAX7219_ORIENTATION
        int "Module pixel orientation (-1 = not yet determined)"
        range -1 7
        default -1
        help
            Generic MAX7219 boards differ in how the chip's digit and segment
            lines are wired to the LED grid, and it cannot be detected in
            software - the part has no MISO to read back.

            Leave at -1 to boot into the bring-up loop, which cycles all eight
            orientations showing a readable glyph. Note the index whose output
            is upright and correct, then set it here.

            The eight values are the symmetries of a square:
              0 plain          1 transpose
              2 flipX          3 transpose+flipX
              4 flipY          5 transpose+flipY
              6 flipX+flipY    7 transpose+flipX+flipY


    menu "Hardware self-test (Latin reference)"

        config SELFTEST_ENABLE
            bool "Scroll a Latin test message at boot"
            default y
            help
                Proves wiring, SPI, cascade order, pixel mapping and packing
                using text whose correct appearance is unmistakable. Runs once
                at boot and stops the moment a real frame arrives.

                This is reference tooling, not the product's text path: Arabic
                is shaped by the browser and arrives as pixels.

        config SELFTEST_WORD
            string "Short word for the mapping test"
            default "R"
            help
                Shown static under each candidate mapping during bring-up.

                The default is a single "R" because it fits an 8x8 module and
                is asymmetric both horizontally and vertically - mirrored,
                rotated or upside-down is obvious at a glance. A symmetric
                glyph like H or O would look correct under several mappings
                and tell you nothing.

                At 6px per character, widen this once the panel is wider:
                a 32px panel holds 5 characters.

        config SELFTEST_TEXT
            string "Scrolling test message"
            depends on SELFTEST_ENABLE
            default "HELLO WORLD 0123456789"

        config SELFTEST_SCROLL_MS
            int "Milliseconds per scroll step"
            depends on SELFTEST_ENABLE
            range 10 500
            default 60

    endmenu

    menu "WiFi access point"

        config AP_SSID
            string "Access point name (SSID)"
            default "ARABIC-LED"
            help
                The network the phone joins. No router is involved.

        config AP_PASSWORD
            string "Access point password"
            default ""
            help
                Leave empty for an open network. WPA2 requires at least 8
                characters - a shorter one is rejected outright, so the
                firmware falls back to open rather than failing to start.

    endmenu

    menu "Frame link"

        config FRAME_UART_ENABLE
            bool "Also accept frames over UART"
            default n
            help
                The web UI is the primary transport, so this is off by default.

                Installing the UART driver on UART0 fights the console driver
                that ESP-IDF logs through, which corrupts log output. If you
                enable this, put it on UART1 or UART2 with its own pins rather
                than sharing UART0 with the console.

        config FRAME_UART_NUM
            int "UART port number"
            depends on FRAME_UART_ENABLE
            range 0 2
            default 2
            help
                Avoid 0: it is the console port. See the warning above.

        config FRAME_UART_BAUD
            int "UART baud rate"
            depends on FRAME_UART_ENABLE
            default 115200

        config FRAME_MAX_PAYLOAD
            int "Maximum frame payload (bytes)"
            default 2048
            help
                A scrolling phrase is sent as one wide frame, so this bounds the
                longest message: 2048 bytes at 8 rows is 2040 pixels wide.

    endmenu

endmenu
```
